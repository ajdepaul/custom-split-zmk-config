## boards/shields/custom_split/Kconfig.shield
```kconfig
# No whitespace after the comma or in your part name!
config SHIELD_CUSTOM_SPLIT_LEFT
    def_bool $(shields_list_contains,custom_split_left)

# No whitespace after the comma or in your part name!
config SHIELD_CUSTOM_SPLIT_RIGHT
    def_bool $(shields_list_contains,custom_split_right)
```
