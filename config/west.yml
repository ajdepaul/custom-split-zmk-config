## config/west.yml
```yaml
manifest:
  remotes:
    - name: zmkfirmware
      url-base: https://github.com/zmkfirmware
    - name: ajdepaul
      url-base: https://github.com/ajdepaul
  projects:
    - name: zmk
      remote: zmkfirmware
      revision: v0.3.0
      import: app/west.yml
    - name: nice-view-cat
      remote: ajdepaul
      revision: main
  self:
    path: config
```
